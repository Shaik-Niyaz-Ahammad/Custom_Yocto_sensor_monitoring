## meta-embedded-monitor/conf/layer.conf
```bitbake
# We have a conf and classes directory, add to BBPATH
BBPATH .= ":${LAYERDIR}"

# We have recipes-* directories, add to BBFILES
BBFILES += "${LAYERDIR}/recipes-*/*/*.bb \
            ${LAYERDIR}/recipes-*/*/*.bbappend"

BBFILE_COLLECTIONS += "meta-embedded-monitor"
BBFILE_PATTERN_meta-embedded-monitor = "^${LAYERDIR}/"
BBFILE_PRIORITY_meta-embedded-monitor = "6"

LAYERDEPENDS_meta-embedded-monitor = "core"
LAYERSERIES_COMPAT_meta-embedded-monitor = "scarthgap"
```
